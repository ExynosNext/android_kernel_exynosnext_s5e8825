## vendor/samsung/Kconfig
```kconfig
menu "Samsung Exynos 1280 Vendor Modules"

source "vendor/samsung/soc/acpm/Kconfig"
source "vendor/samsung/pinctrl/Kconfig"
source "vendor/samsung/mfd/Kconfig"
source "vendor/samsung/regulator/Kconfig"
source "vendor/samsung/clock/Kconfig"
source "vendor/samsung/watchdog/Kconfig"
source "vendor/samsung/rtc/Kconfig"
source "vendor/samsung/thermal/Kconfig"
source "vendor/samsung/display/Kconfig"
source "vendor/samsung/gpu/Kconfig"
source "vendor/samsung/media/Kconfig"
source "vendor/samsung/audio/Kconfig"
source "vendor/samsung/modem/Kconfig"
source "vendor/samsung/wifi/Kconfig"
source "vendor/samsung/input/Kconfig"
source "vendor/samsung/sensors/Kconfig"
source "vendor/samsung/battery/Kconfig"
source "vendor/samsung/fingerprint/Kconfig"

endmenu
```

## vendor/samsung/audio/Kconfig
```kconfig
config SND_SOC_SAMSUNG_ABOX
	tristate "Samsung ABOX Audio DSP"
	depends on ARCH_EXYNOS
	help
	  Samsung ABOX (Audio Box) DSP processor driver.

config SND_SOC_RT5665
	tristate "Realtek RT5665 Audio Codec"
	depends on I2C
	help
	  Realtek RT5665 audio codec driver for Samsung platforms.

config SND_SOC_RT5691
	tristate "Realtek RT5691 Audio Codec"
	depends on I2C
	help
	  Realtek RT5691 audio codec driver for Samsung platforms.

config SND_SOC_TFA9878
	tristate "NXP TFA9878 Smart Audio Amplifier"
	depends on I2C
	help
	  NXP TFA9878 smart audio amplifier driver.

config SND_SOC_AW882XX
	tristate "Awinic AW882XX Smart Audio Amplifier"
	depends on I2C
	help
	  Awinic AW882XX smart audio amplifier driver.

config SND_SOC_TAS2562
	tristate "TI TAS2562 Audio Amplifier"
	depends on I2C
	help
	  Texas Instruments TAS2562 audio amplifier driver.

config SND_SOC_SAMSUNG_VTS
	tristate "Samsung VTS (Voice Trigger Service)"
	depends on SND_SOC_SAMSUNG_ABOX
	help
	  Samsung Voice Trigger Service audio driver.

config SND_SOC_SAMSUNG_SLIF
	tristate "Samsung SLIF (Sound Link Interface)"
	depends on SND_SOC_SAMSUNG_ABOX
	help
	  Samsung Sound Link Interface audio driver.
```

## vendor/samsung/battery/Kconfig
```kconfig
config BATTERY_SAMSUNG
	tristate "Samsung Battery Driver"
	depends on POWER_SUPPLY
	help
	  Samsung battery driver for charging and power management.

config STEP_CHARGING
	bool "Step Charging"
	depends on BATTERY_SAMSUNG
	help
	  Enable step charging algorithm for battery health.

config ENABLE_FULL_BY_SOC
	bool "Enable Full by SOC"
	depends on BATTERY_SAMSUNG
	help
	  Enable full charge detection by SOC percentage.

config SEC_PD
	tristate "Samsung Power Delivery"
	depends on BATTERY_SAMSUNG
	help
	  Samsung USB Power Delivery protocol support.

config BATTERY_CISD
	bool "Battery CISD"
	depends on BATTERY_SAMSUNG
	help
	  Enable Battery Charging Intelligent Safety Detection.

config AFC_CHARGER_MODE
	bool "AFC Charger Mode"
	depends on BATTERY_SAMSUNG
	help
	  Enable Samsung Adaptive Fast Charging protocol.

config BATTERY_AGE_FORECAST
	bool "Battery Age Forecast"
	depends on BATTERY_SAMSUNG
	help
	  Enable battery age and health forecasting.

config BATTERY_LOGGING
	bool "Battery Logging"
	depends on BATTERY_SAMSUNG
	help
	  Enable battery event logging.

config UPDATE_BATTERY_DATA
	bool "Update Battery Data"
	depends on BATTERY_SAMSUNG
	help
	  Enable dynamic battery data updates.

config LIMIT_CHARGING_DURING_CALL
	bool "Limit Charging During Call"
	depends on BATTERY_SAMSUNG
	help
	  Limit charging current during phone calls.

config BATTERY_GKI
	bool "Battery GKI Support"
	depends on BATTERY_SAMSUNG
	help
	  Enable GKI (Generic Kernel Image) battery support.

config SUPPORT_HV_CTRL
	bool "HV Control"
	depends on BATTERY_SAMSUNG
	help
	  Enable high voltage charging control.

config BATTERY_SAMSUNG_REBOOT
	bool "Battery Samsung Reboot"
	depends on BATTERY_SAMSUNG
	help
	  Enable battery-related reboot handling.

config DIRECT_CHARGING
	tristate "Direct Charging"
	depends on BATTERY_SAMSUNG
	help
	  Samsung direct charging protocol support.

config CHARGER_S2MF301
	tristate "Samsung S2MF301 Charger"
	depends on I2C
	help
	  Samsung S2MF301 charging IC driver.

config CHARGER_HL7132
	tristate "Silergy HL7132 Charger"
	depends on I2C
	help
	  Silergy HL7132 direct charging IC driver.

config LSI_IFPMIC
	tristate "Samsung IF PMIC"
	depends on I2C
	help
	  Samsung Interface PMIC driver for battery management.

config FUELGAUGE_S2MF301
	tristate "Samsung S2MF301 Fuel Gauge"
	depends on I2C
	help
	  Samsung S2MF301 fuel gauge driver for SOC measurement.

config FUELGAUGE_S2MF301_USE_5MILLIOHM
	bool "S2MF301 5 milliohm sense resistor"
	depends on FUELGAUGE_S2MF301
	help
	  Use 5 milliohm sense resistor for S2MF301 fuel gauge.

config UI_SOC_PROLONGING
	bool "UI SOC Prolonging"
	depends on BATTERY_SAMSUNG
	help
	  Extend UI SOC display to prevent sudden shutdowns.

config HICCUP_CHARGER
	bool "Hiccup Charger"
	depends on BATTERY_SAMSUNG
	help
	  Enable hiccup charging mode for battery recovery.

config SENSOR_RETENTION_USE
	bool "Sensor Retention"
	depends on BATTERY_SAMSUNG
	help
	  Enable sensor data retention during suspend.
```

## vendor/samsung/clock/Kconfig
```kconfig
config COMMON_CLK_S5E8825
	tristate "Samsung Exynos 1280 Clock Controller"
	depends on COMMON_CLK
	depends on OF || COMPILE_TEST
	default m if OF
	help
	  Clock controller driver for Samsung Exynos 1280 (s5e8825) SoC.
	  Uses the generic clk-provider API for GKI module compatibility.
	  Builds as a loadable module (.ko) against the android17-6.18 GKI
	  tree.
```

## vendor/samsung/display/Kconfig
```kconfig
config DRM_SAMSUNG_DPU
	tristate "Samsung Exynos Display Processing Unit"
	depends on DRM_SAMSUNG
	help
	  Samsung Exynos display processing unit driver.

config DRM_SAMSUNG_DSI
	tristate "Samsung Exynos MIPI DSI Controller"
	depends on DRM_SAMSUNG_DPU
	help
	  Samsung Exynos MIPI DSI controller driver.

config DRM_SAMSUNG_PANEL
	tristate "Samsung Exynos Panel Framework"
	depends on DRM_SAMSUNG_DSI
	help
	  Samsung Exynos display panel framework.

config DRM_MCD_PANEL
	tristate "Samsung MCD Panel Driver"
	depends on DRM_SAMSUNG_PANEL
	help
	  Samsung MCD (Mobile Content Display) panel driver.

config DRM_MCD_HDR
	bool "Samsung MCD HDR Support"
	depends on DRM_MCD_PANEL
	help
	  Enable HDR support for MCD panels.

config USDM_MDNIE
	tristate "Samsung MDNIE Display Mode"
	depends on DRM_SAMSUNG_DSI
	help
	  Samsung MDNIE (Mobile Display Natural Image Engine) support.

config USDM_MDNIE_AFC
	bool "Samsung MDNIE AFC Support"
	depends on USDM_MDNIE
	help
	  Enable MDNIE Auto Function Control.

config USDM_MDNIE_TUNING
	bool "Samsung MDNIE Tuning"
	depends on USDM_MDNIE
	help
	  Enable MDNIE tuning parameters.

config USDM_PANEL_COPR
	tristate "Samsung Panel COPR Support"
	depends on DRM_SAMSUNG_PANEL
	help
	  Samsung panel COPR (Color and Power Reduction) support.

config PANEL_COPR
	tristate "Samsung Panel COPR Driver"
	depends on USDM_PANEL_COPR
	help
	  Samsung panel COPR driver.

config PANEL_VRR_BRIDGE
	tristate "Samsung Panel VRR Bridge"
	depends on DRM_SAMSUNG_PANEL
	help
	  Samsung panel Variable Refresh Rate bridge.

config PANEL_FREQ_HOP
	tristate "Samsung Panel Frequency Hopping"
	depends on DRM_SAMSUNG_PANEL
	help
	  Samsung panel frequency hopping for EMI reduction.

config PANEL_DISPLAY_MODE
	tristate "Samsung Panel Display Mode"
	depends on DRM_SAMSUNG_PANEL
	help
	  Samsung panel display mode control.

config PANEL_AID_DIMMING
	tristate "Samsung Panel AID Dimming"
	depends on DRM_SAMSUNG_PANEL
	help
	  Samsung panel Adaptive Image Display dimming.

config PANEL_MDNIE_LIGHT_NOTIFICATION
	tristate "Samsung MDNIE Light Notification"
	depends on USDM_MDNIE
	help
	  Samsung MDNIE light notification support.

config SUPPORT_DYNAMIC_HLPM
	bool "Samsung Dynamic HLPM Support"
	depends on DRM_SAMSUNG_PANEL
	help
	  Enable dynamic HLPM (High Luminance Power Mode).

config MCD_PANEL_LPM
	tristate "Samsung MCD Panel LPM"
	depends on DRM_MCD_PANEL
	help
	  Samsung MCD panel Low Power Mode.

config MCD_PANEL_BLIC
	tristate "Samsung MCD Panel BLIC"
	depends on DRM_MCD_PANEL
	help
	  Samsung MCD panel BackLight IC driver.
```

## vendor/samsung/fingerprint/Kconfig
```kconfig
config FINGERPRINT_EGSTEC
	tristate "EgisTec Fingerprint Sensor"
	depends on SPI
	help
	  EgisTec optical fingerprint sensor driver.

config FINGERPRINT_SECURE
	bool "Fingerprint Secure Support"
	depends on FINGERPRINT_EGSTEC
	help
	  Enable secure fingerprint authentication path.
```

## vendor/samsung/gpu/Kconfig
```kconfig
config MALI_MIDGARD
	tristate "ARM Mali Midgard GPU"
	depends on ARCH_EXYNOS
	help
	  ARM Mali Midgard GPU kernel support for Samsung Exynos.

config MALI_EXYNOS_DVFS
	bool "Mali Exynos DVFS Support"
	depends on MALI_MIDGARD
	help
	  Enable DVFS (Dynamic Voltage and Frequency Scaling) for Mali GPU.

config MALI_EXYNOS_RTPM
	bool "Mali Exynos Runtime PM"
	depends on MALI_MIDGARD
	help
	  Enable runtime power management for Mali GPU.

config MALI_EXYNOS_PM
	bool "Mali Exynos Power Management"
	depends on MALI_MIDGARD
	depends on PM
	help
	  Enable power management for Mali GPU.

config MALI_EXYNOS_IFPO
	bool "Mali Exynos IFPO"
	depends on MALI_MIDGARD
	help
	  Enable IFPO (Integrated Frame Buffer Power Optimization) for Mali GPU.

config MALI_CL_BOOST
	bool "Mali CL Boost"
	depends on MALI_MIDGARD
	help
	  Enable CL boost for Mali GPU performance.
```

## vendor/samsung/input/Kconfig
```kconfig
config SEC_INPUT
	tristate "Samsung Input Core"
	depends on INPUT
	help
	  Samsung core input subsystem driver.

config SEC_INPUT_BOOSTER
	bool "Samsung Input Booster"
	depends on SEC_INPUT
	help
	  Enable input response booster for touch latency optimization.

config SEC_TOUCHSCREEN_DEVICE
	tristate "Samsung Touchscreen Device"
	depends on SEC_INPUT
	help
	  Samsung touchscreen device driver.
```

## vendor/samsung/media/Kconfig
```kconfig
config MEDIA_SAMSUNG_MFC
	tristate "Samsung MFC (Multi-Format Codec)"
	depends on ARCH_EXYNOS
	help
	  Samsung Exynos Multi-Format Codec driver for video encoding/decoding.

config CONFIG_VIDEO_EXYNOS_MFC_BUFFER_ALIGN_128B
	bool "MFC 128-byte Buffer Alignment"
	depends on MEDIA_SAMSUNG_MFC
	help
	  Align MFC video buffers to 128-byte boundaries for cache performance.
```

## vendor/samsung/mfd/Kconfig
```kconfig
# SPDX-License-Identifier: GPL-2.0

config MFD_S2MPS34
	tristate "Samsung S2MPS34 PMIC core driver"
	depends on I2C
	depends on OF
	select REGMAP_I2C
	select MFD_CORE
	default y
	help
	  This enables the Samsung S2MPS34 PMIC core driver. The S2MPS34
	  is the PMIC for the Samsung Exynos 1280 (s5e8825) SoC, providing
	  39 LDOs, 9 BUCK regulators, RTC, and watchdog.

	  The PMIC is accessed via I2C through the ACPM MFD bus
	  (an I2C-over-ACPM-IPC tunnel) or a direct I2C bus.

	  Must be enabled for the S2MPS34 regulator and RTC drivers.
```

## vendor/samsung/modem/Kconfig
```kconfig
config SAMSUNG_CPIF
	tristate "Samsung CPIF (Common Protocol Interface)"
	depends on ARCH_EXYNOS
	help
	  Samsung Common Protocol Interface for modem communication.

config SAMSUNG_CPIF_SMP2P
	bool "Samsung CPIF SMP2P Support"
	depends on SAMSUNG_CPIF
	help
	  Enable SMP2P (Shared Memory Point to Point) for CPIF.

config SAMSUNG_MODEMCTL
	tristate "Samsung Modem Control"
	depends on SAMSUNG_CPIF
	help
	  Samsung modem control driver for firmware management.
```

## vendor/samsung/pinctrl/Kconfig
```kconfig
# SPDX-License-Identifier: GPL-2.0

config PINCTRL_S5E8825
	tristate "Samsung Exynos 1280 pinctrl driver"
	depends on OF
	select PINMUX
	select PINCONF
	select GENERIC_PINCONF
	select GPIOLIB
	select GPIOLIB_IRQCHIP
	default y
	help
	  Pinctrl and GPIO driver for Samsung Exynos 1280 (s5e8825).
	  Uses standard Linux pinctrl/pinmux/pinconf subsystems and the
	  generic GPIO chip interface — fully mainline-compatible.

	  Supports 7 pinctrl controllers with 48 GPIO banks total, covering
	  alive, peri, fsys, core, and audio domains.

	  The driver registers pin configurations (function select, pull
	  up/down, drive strength) via the standard pinconf-generic
	  framework, making it compatible with standard DT bindings like:
	    pinctrl-0 = <&uart0_bus>;
	    samsung,pins = "gpa0-0", "gpa0-1";
	    samsung,pin-function = <2>;
	    samsung,pin-pud = <3>;
```

## vendor/samsung/regulator/Kconfig
```kconfig
# SPDX-License-Identifier: GPL-2.0

config REGULATOR_S2MPS34
	tristate "Samsung S2MPS34 regulator support"
	depends on MFD_S2MPS34
	select REGULATOR
	default y
	help
	  This enables the regulator driver for the Samsung S2MPS34 PMIC.
	  Provides 39 LDOs and 9 BUCK regulators via the standard Linux
	  regulator subsystem, using the regmap-based regulator framework.
```

## vendor/samsung/rtc/Kconfig
```kconfig
# SPDX-License-Identifier: GPL-2.0

config RTC_DRV_EXYNOS1280
	tristate "Samsung Exynos 1280 RTC driver"
	depends on OF
	select RTC_CLASS
	default y
	help
	  RTC driver for Samsung Exynos 1280 (s5e8825).
	  Uses the standard Linux RTC subsystem.
```

## vendor/samsung/sensors/Kconfig
```kconfig
config SHUB
	tristate "Samsung SensorHub"
	depends on ARCH_EXYNOS
	help
	  Samsung SensorHub co-processor driver for sensor management.

config SHUB_PM_WAKEUP_LINUX_VER_5_4
	bool "SensorHub PM Wakeup Linux 5.4"
	depends on SHUB
	help
	  Enable PM wakeup support for Linux 5.4.

config SHUB_AOIS
	bool "SensorHub AOIS Support"
	depends on SHUB
	help
	  Enable Active Optical Image Stabilization via SensorHub.

config SHUB_PANEL_NOTIFY
	bool "SensorHub Panel Notification"
	depends on SHUB
	help
	  Enable panel notification support for SensorHub.

config SHUB_MODULE
	tristate "SensorHub Module"
	depends on SHUB
	help
	  Samsung SensorHub loadable module support.

config SHUB_LSI
	bool "SensorHub LSI Support"
	depends on SHUB
	help
	  Enable LSI (Large Scale Integration) SensorHub support.

config SENSORS_SX9380
	tristate "Semtech SX9380 Proximity Sensor"
	depends on I2C
	help
	  Semtech SX9380 SAR/proximity sensor driver.

config SENSORS_A96T396
	tristate "Awinic A96T396 Touch Key"
	depends on I2C
	help
	  Awinic A96T396 capacitive touch key driver.

config SENSORS_ISG5320A
	tristate "Samsung ISG5320A Force Sensor"
	depends on I2C
	help
	  Samsung ISG5320A force/touch sensor driver.

config SENSORS_ISG6320
	tristate "Samsung ISG6320 Force Sensor"
	depends on I2C
	help
	  Samsung ISG6320 force/touch sensor driver.
```

## vendor/samsung/soc/acpm/Kconfig
```kconfig
# SPDX-License-Identifier: GPL-2.0

config EXYNOS_ACPM
	tristate "Samsung Exynos ACPM IPC driver"
	depends on OF
	select EXYNOS_ACPM_FRAMEWORK
	default y
	help
	  This enables the ACPM (Audio Co-Processor Manager) IPC framework
	  for Samsung Exynos SoCs. The ACPM co-processor manages clocks,
	  DVFS, PMIC regulators, and thermal on behalf of the AP.

	  The clock controller, devfreq, thermal, and PMIC drivers all
	  depend on this framework to communicate with the ACPM.

	  Build as a built-in (y) — the ACPM must be available early
	  in boot before any clock/DVFS operations.

config EXYNOS_ACPM_FRAMEWORK
	bool
	help
	  Internal config to track ACPM framework dependency.

config EXYNOS_ACPM_S2D
	tristate "Samsung Exynos ACPM S2D (Silent to Dram) support"
	depends on EXYNOS_ACPM
	default y
	help
	  S2D (Silent to Dram) plugin for the ACPM. Captures debug
	  information to DRAM on system crashes.
```

## vendor/samsung/thermal/Kconfig
```kconfig
# SPDX-License-Identifier: GPL-2.0

config EXYNOS1280_TMU
	tristate "Samsung Exynos 1280 TMU thermal driver"
	depends on OF
	depends on THERMAL
	default y
	help
	  Thermal Management Unit driver for Samsung Exynos 1280 (s5e8825).
	  Uses the standard Linux thermal subsystem. Monitors CPU clusters,
	  GPU, and ISP temperatures.
```

## vendor/samsung/watchdog/Kconfig
```kconfig
# SPDX-License-Identifier: GPL-2.0

config EXYNOS1280_WDT
	tristate "Samsung Exynos 1280 watchdog driver"
	depends on OF
	select WATCHDOG_CORE
	default y
	help
	  Watchdog timer driver for Samsung Exynos 1280 (s5e8825).
	  Uses the standard Linux watchdog subsystem.
```
